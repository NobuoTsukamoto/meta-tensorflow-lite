## conf/layer.conf
```bitbake
# We have a conf and classes directory, add to BBPATH
BBPATH .= ":${LAYERDIR}"

# We have recipes-* directories, add to BBFILES
BBFILES += "${LAYERDIR}/recipes-*/*/*.bb \
            ${LAYERDIR}/recipes-*/*/*.bbappend"

BBFILE_COLLECTIONS += "meta-tensorflow-lite"
BBFILE_PATTERN_meta-tensorflow-lite = "^${LAYERDIR}/"
BBFILE_PRIORITY_meta-tensorflow-lite = "6"

LAYERDEPENDS_meta-tensorflow-lite = "core"
LAYERSERIES_COMPAT_meta-tensorflow-lite = "honister"
```
